#include <physical_layouts.dtsi>

/ {
    charybdis_physical_layout: charybdis_physical_layout {
        compatible = "zmk,physical-layout";
        display-name = "Charybdis 3x6";

        kscan = <&kscan0>;
        transform = <&default_transform>;

        keys

    };
};
